## CMakeLists.txt
```
# SPDX-License-Identifier: Apache-2.0
# Zephyr application of the robot arm firmware (board: nucleo_g474re, D16).
cmake_minimum_required(VERSION 3.20.0)
find_package(Zephyr REQUIRED HINTS $ENV{ZEPHYR_BASE})
project(robarm_app LANGUAGES C)

target_sources(app PRIVATE src/main.c)
# src/canary.c (canary trace chain, plan task 5.3) is not linked into the firmware; only the test
# tests/canary builds it.
```

## prj.conf
```kconfig
# SPDX-License-Identifier: Apache-2.0
# Kconfig of the robot arm firmware. Skeleton: only console output so far.
CONFIG_PRINTK=y
```

## boards/nucleo_g474re.overlay
```dts
/*
 * SPDX-License-Identifier: Apache-2.0
 *
 * Devicetree overlay of the robot arm firmware for the NUCLEO-G474RE board.
 *
 * Placeholder. The joints (compatible "robot,joint", see dts/bindings/) and the buses to the
 * PCA9685 and MCP3208 breakouts come in Phase 5.
 */

/ {
};
```

## src/main.c
```c
/*
 * SPDX-License-Identifier: Apache-2.0
 */

/**
 * @file
 * @brief Entry point of the robot arm firmware.
 *
 * Skeleton: the firmware only prints a start message. The joint control comes in Phase 5.
 */

#include <zephyr/kernel.h>
#include <zephyr/sys/printk.h>

/**
 * @brief Firmware entry point, called by the Zephyr kernel after start-up.
 *
 * @return 0 always.
 */
int main(void)
{
	printk("robarm-sw firmware skeleton on %s\n", CONFIG_BOARD);
	return 0;
}
```

## src/canary.c
```c
/*
 * SPDX-License-Identifier: Apache-2.0
 */

/**
 * @file
 * @brief Canary module (SW-DD-0001): the output follows the input at once.
 */

#include "canary.h"

int32_t canary_update(int32_t input)
{
	return input;
}
```

## src/canary.h
```c
/*
 * SPDX-License-Identifier: Apache-2.0
 */

/**
 * @file
 * @brief Canary module: one tiny function at the end of the canary trace chain (plan task 5.3).
 *
 * It belongs to the system configuration canary (SYS-CFG-0001) and is not part of the robot arm.
 */

#ifndef ROBARM_CANARY_H_
#define ROBARM_CANARY_H_

#include <stdint.h>

/**
 * @brief Return the new canary output for an input value.
 *
 * @xdid{SW-IMPL-0001}
 * Implements SW-DD-0001.
 * Configs: SYS-CFG-0001.
 *
 * @param input The new canary input value.
 * @return The new output value; it equals @p input.
 */
int32_t canary_update(int32_t input);

#endif /* ROBARM_CANARY_H_ */
```
